## drivers/sensor/si7006/Kconfig
```kconfig
menuconfig SI7006
	bool "SI7006 Temperature and Humidity Sensor"
	depends on (I2C && HAS_DTS_I2C) 
	help
	  Enable I2C-based driver for SI7006 Temperature and Humidity Sensor.
```
